## app/boards/raspberrypi/rpi_pico2/Kconfig.rpi_pico2
```kconfig
# Copyright (c) 2026 The ZMK Contributors
# SPDX-License-Identifier: MIT

config BOARD_RPI_PICO2
    select SOC_RP2350A_M33 if BOARD_RPI_PICO2_RP2350A_M33_ZMK
    select ZMK_BOARD_COMPAT if BOARD_RPI_PICO2_RP2350A_M33_ZMK
    imply RETAINED_MEM if BOARD_RPI_PICO2_RP2350A_M33_ZMK
    imply RETENTION if BOARD_RPI_PICO2_RP2350A_M33_ZMK
    imply RETENTION_BOOT_MODE if BOARD_RPI_PICO2_RP2350A_M33_ZMK
```

## app/boards/raspberrypi/rpi_pico2/board.yml
```yaml
board:
  extend: rpi_pico2
  variants:
    - name: zmk
      qualifier: rp2350a/m33
```
